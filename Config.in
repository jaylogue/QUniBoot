## Config.in
```kconfig
source "$BR2_EXTERNAL_QUNIBOOT_PATH/package/qunibone/Config.in"
source "$BR2_EXTERNAL_QUNIBOOT_PATH/package/qunibone-os-images/Config.in"
source "$BR2_EXTERNAL_QUNIBOOT_PATH/package/qunibone-boot-roms/Config.in"
source "$BR2_EXTERNAL_QUNIBOOT_PATH/package/macro11/Config.in"
source "$BR2_EXTERNAL_QUNIBOOT_PATH/package/open-simh/Config.in"
source "$BR2_EXTERNAL_QUNIBOOT_PATH/package/retro-fuse/Config.in"
source "$BR2_EXTERNAL_QUNIBOOT_PATH/package/pdp11monloader/Config.in"
source "$BR2_EXTERNAL_QUNIBOOT_PATH/package/xxdpdir/Config.in"
source "$BR2_EXTERNAL_QUNIBOOT_PATH/package/cross-libtool/Config.in"
source "$BR2_EXTERNAL_QUNIBOOT_PATH/package/libt3config/Config.in"
source "$BR2_EXTERNAL_QUNIBOOT_PATH/package/libtranscript/Config.in"
source "$BR2_EXTERNAL_QUNIBOOT_PATH/package/libt3window/Config.in"
source "$BR2_EXTERNAL_QUNIBOOT_PATH/package/libt3key/Config.in"
source "$BR2_EXTERNAL_QUNIBOOT_PATH/package/libt3highlight/Config.in"
source "$BR2_EXTERNAL_QUNIBOOT_PATH/package/libt3widget/Config.in"
source "$BR2_EXTERNAL_QUNIBOOT_PATH/package/tilde/Config.in"
```

## configs/qunibone_defconfig
```kconfig
BR2_arm=y
BR2_cortex_a8=y
BR2_TOOLCHAIN_EXTERNAL=y
BR2_TOOLCHAIN_EXTERNAL_BOOTLIN=y
BR2_TOOLCHAIN_EXTERNAL_GDB_SERVER_COPY=y
BR2_CCACHE=y
BR2_CCACHE_DIR="$(BR2_EXTERNAL_QUNIBONE_PATH)/.buildroot-ccache"
BR2_PACKAGE_OVERRIDE_FILE="$(BR2_EXTERNAL_QUNIBONE_PATH)/local.mk"
BR2_TARGET_GENERIC_HOSTNAME=""
BR2_TARGET_GENERIC_ISSUE=""
BR2_ROOTFS_DEVICE_CREATION_DYNAMIC_MDEV=y
BR2_TARGET_GENERIC_ROOT_PASSWD="root"
BR2_SYSTEM_BIN_SH_BASH=y
BR2_TARGET_GENERIC_GETTY_BAUDRATE_115200=y
BR2_TARGET_GENERIC_GETTY_TERM="linux"
BR2_TARGET_GENERIC_GETTY_OPTIONS="-n -l /bin/bash"
BR2_SYSTEM_DHCP="eth0"
BR2_TARGET_TZ_INFO=y
BR2_ROOTFS_OVERLAY="$(BR2_EXTERNAL_QUNIBONE_PATH)/rootfs-overlay"
BR2_ROOTFS_POST_BUILD_SCRIPT="$(BR2_EXTERNAL_QUNIBONE_PATH)/scripts/post-build.sh"
BR2_ROOTFS_POST_FAKEROOT_SCRIPT="$(BR2_EXTERNAL_QUNIBONE_PATH)/scripts/post-fakeroot.sh"
BR2_ROOTFS_POST_IMAGE_SCRIPT="$(BR2_EXTERNAL_QUNIBONE_PATH)/scripts/post-image.sh"
BR2_ROOTFS_POST_BUILD_SCRIPT_ARGS="$(QUNIBONE_PLATFORM)"
BR2_ROOTFS_POST_IMAGE_SCRIPT_ARGS="$(QUNIBONE_PLATFORM)"
BR2_LINUX_KERNEL=y
BR2_LINUX_KERNEL_CUSTOM_TARBALL=y
BR2_LINUX_KERNEL_CUSTOM_TARBALL_LOCATION="$(call github,beagleboard,linux,6.6.58-ti-rt-arm32-r10)/linux-6.6.58-ti-rt-arm32-r10.tar.gz"
BR2_LINUX_KERNEL_DEFCONFIG="bb.org"
BR2_LINUX_KERNEL_CONFIG_FRAGMENT_FILES="$(BR2_EXTERNAL_QUNIBONE_PATH)/board/qunibone/linux_defconfig"
BR2_LINUX_KERNEL_LZO=y
BR2_LINUX_KERNEL_DTS_SUPPORT=y
BR2_LINUX_KERNEL_INTREE_DTS_NAME="ti/omap/am335x-boneblack"
BR2_LINUX_KERNEL_DTB_OVERLAY_SUPPORT=y
BR2_PACKAGE_BUSYBOX_CONFIG="$(BR2_EXTERNAL_QUNIBONE_PATH)/board/qunibone/busybox_defconfig"
BR2_PACKAGE_BUSYBOX_SHOW_OTHERS=y
BR2_PACKAGE_XZ=y
BR2_PACKAGE_GDB=y
BR2_PACKAGE_GDB_DEBUGGER=y
BR2_PACKAGE_GDB_TUI=y
BR2_PACKAGE_DIFFUTILS=y
BR2_PACKAGE_FINDUTILS=y
BR2_PACKAGE_GIT=y
BR2_PACKAGE_GREP=y
BR2_PACKAGE_LIBTOOL=y
BR2_PACKAGE_MAKE=y
BR2_PACKAGE_PATCH=y
BR2_PACKAGE_SED=y
BR2_PACKAGE_TREE=y
BR2_PACKAGE_E2FSPROGS=y
BR2_PACKAGE_E2FSPROGS_RESIZE2FS=y
BR2_PACKAGE_AM335X_PRU_PACKAGE=y
BR2_PACKAGE_EVTEST=y
BR2_PACKAGE_I2C_TOOLS=y
BR2_PACKAGE_MINICOM=y
BR2_PACKAGE_PARTED=y
BR2_PACKAGE_PICOCOM=y
BR2_PACKAGE_PRU_SOFTWARE_SUPPORT=y
BR2_PACKAGE_PERL=y
BR2_PACKAGE_PYTHON3=y
BR2_PACKAGE_PYTHON_PIP=y
BR2_PACKAGE_CA_CERTIFICATES=y
BR2_PACKAGE_LIBFUSE=y
BR2_PACKAGE_LIBGPIOD2=y
BR2_PACKAGE_LIBGPIOD2_TOOLS=y
BR2_PACKAGE_LIBCURL=y
BR2_PACKAGE_LIBCURL_CURL=y
BR2_PACKAGE_LIBCURL_VERBOSE=y
BR2_PACKAGE_LIBPCAP=y
BR2_PACKAGE_LIBTIRPC=y
BR2_PACKAGE_LIBEDIT=y
BR2_PACKAGE_LINENOISE=y
BR2_PACKAGE_NCURSES_WCHAR=y
BR2_PACKAGE_PCRE=y
BR2_PACKAGE_PCRE_32=y
BR2_PACKAGE_PCRE_UTF=y
BR2_PACKAGE_PCRE2=y
BR2_PACKAGE_PCRE2_32=y
BR2_PACKAGE_BC=y
BR2_PACKAGE_AVAHI=y
# BR2_PACKAGE_AVAHI_AUTOIPD is not set
BR2_PACKAGE_AVAHI_DAEMON=y
BR2_PACKAGE_AVAHI_DEFAULT_SERVICES=y
BR2_PACKAGE_IPROUTE2=y
BR2_PACKAGE_OPENSSH=y
# BR2_PACKAGE_OPENSSH_SANDBOX is not set
BR2_PACKAGE_RSYNC=y
BR2_PACKAGE_WGET=y
# BR2_PACKAGE_URANDOM_SCRIPTS is not set
BR2_PACKAGE_SCREEN=y
BR2_PACKAGE_TIME=y
BR2_PACKAGE_TMUX=y
BR2_PACKAGE_WHICH=y
BR2_PACKAGE_COREUTILS=y
BR2_PACKAGE_KMOD=y
BR2_PACKAGE_KMOD_TOOLS=y
BR2_PACKAGE_PROCPS_NG=y
BR2_PACKAGE_PROCPS_NG_ORIGINAL_TOP=y
BR2_PACKAGE_PSMISC=y
BR2_PACKAGE_TAR=y
BR2_PACKAGE_UTIL_LINUX_BINARIES=y
BR2_PACKAGE_ED=y
BR2_PACKAGE_LESS=y
BR2_PACKAGE_NANO=y
BR2_PACKAGE_UEMACS=y
BR2_PACKAGE_VIM=y
BR2_TARGET_ROOTFS_EXT2=y
BR2_TARGET_ROOTFS_EXT2_4=y
BR2_TARGET_ROOTFS_EXT2_LABEL="ROOTFS"
BR2_TARGET_ROOTFS_EXT2_SIZE="496M"
# BR2_TARGET_ROOTFS_TAR is not set
BR2_TARGET_UBOOT=y
BR2_TARGET_UBOOT_BUILD_SYSTEM_KCONFIG=y
BR2_TARGET_UBOOT_CUSTOM_VERSION=y
BR2_TARGET_UBOOT_CUSTOM_VERSION_VALUE="2022.04"
BR2_TARGET_UBOOT_USE_CUSTOM_CONFIG=y
BR2_TARGET_UBOOT_CUSTOM_CONFIG_FILE="$(BR2_EXTERNAL_QUNIBONE_PATH)/board/qunibone/uboot_defconfig"
# BR2_TARGET_UBOOT_FORMAT_BIN is not set
BR2_TARGET_UBOOT_FORMAT_IMG=y
BR2_TARGET_UBOOT_SPL=y
BR2_TARGET_UBOOT_SPL_NAME="MLO"
BR2_PACKAGE_HOST_BMAP_TOOLS=y
BR2_PACKAGE_HOST_GENIMAGE=y
BR2_PACKAGE_HOST_KMOD_XZ=y
BR2_PACKAGE_HOST_UBOOT_TOOLS=y
BR2_PACKAGE_QUNIBONE=y
BR2_PACKAGE_QUNIBONE_OS_IMAGES=y
BR2_PACKAGE_QUNIBONE_BOOT_ROMS=y
BR2_PACKAGE_MACRO11=y
BR2_PACKAGE_OPEN_SIMH=y
BR2_PACKAGE_RETRO_FUSE=y
BR2_PACKAGE_PDP11MONLOADER=y
BR2_PACKAGE_XXDPDIR=y
```

## package/cross-libtool/Config.in
```kconfig
config BR2_PACKAGE_HOST_CROSS_LIBTOOL
	bool "cross-libtool"
	help
		Build a version of libtool for cross compilation.
```

## package/libt3config/Config.in
```kconfig
config BR2_PACKAGE_LIBT3CONFIG
	bool "libt3config"
	select BR2_PACKAGE_HOST_CROSS_LIBTOOL
	help
	  Library for reading and writing configuration files in the
	  t3config format. It is used by the tilde text editor and by
	  other T3 libraries.

	  https://os.ghalkes.nl/t3/libt3config.html
```

## package/libt3highlight/Config.in
```kconfig
config BR2_PACKAGE_LIBT3HIGHLIGHT
	bool "libt3highlight"
	select BR2_PACKAGE_HOST_CROSS_LIBTOOL
	select BR2_PACKAGE_LIBT3CONFIG
	select BR2_PACKAGE_PCRE2
	help
	  Library for syntax highlighting of text files. The syntax
	  definitions for the supported languages are stored as data files
	  and interpreted at run time. It is used by the tilde text editor.

	  https://os.ghalkes.nl/t3/libt3highlight.html
```

## package/libt3key/Config.in
```kconfig
config BR2_PACKAGE_LIBT3KEY
	bool "libt3key"
	select BR2_PACKAGE_HOST_CROSS_LIBTOOL
	select BR2_PACKAGE_LIBT3CONFIG
	help
	  Library that translates terminal key press sequences into
	  abstract key names, using key mapping files that describe the
	  key sequences of common terminals. It is used by the tilde text
	  editor and by other T3 libraries.

	  https://os.ghalkes.nl/t3/libt3key.html
```

## package/libt3widget/Config.in
```kconfig
config BR2_PACKAGE_LIBT3WIDGET
	bool "libt3widget"
	depends on BR2_TOOLCHAIN_HAS_THREADS
	depends on BR2_INSTALL_LIBSTDCPP
	select BR2_PACKAGE_HOST_CROSS_LIBTOOL
	select BR2_PACKAGE_LIBT3KEY
	select BR2_PACKAGE_LIBT3WINDOW
	select BR2_PACKAGE_LIBTRANSCRIPT
	select BR2_PACKAGE_LIBUNISTRING
	select BR2_PACKAGE_PCRE2
	help
	  C++ library of user interface widgets for console applications.
	  It provides the text, list and dialog widgets used by the tilde
	  text editor. X11 and GPM support are disabled.

	  https://os.ghalkes.nl/t3/libt3widget.html
```

## package/libt3window/Config.in
```kconfig
config BR2_PACKAGE_LIBT3WINDOW
	bool "libt3window"
	select BR2_PACKAGE_HOST_CROSS_LIBTOOL
	select BR2_PACKAGE_LIBT3CONFIG
	select BR2_PACKAGE_LIBTRANSCRIPT
	select BR2_PACKAGE_LIBUNISTRING
	select BR2_PACKAGE_NCURSES
	help
	  C library implementing the console window handling for the T3
	  user interface libraries. It provides the window, screen and
	  character cell abstractions on top of ncurses.

	  https://os.ghalkes.nl/t3/libt3window.html
```

## package/libtranscript/Config.in
```kconfig
config BR2_PACKAGE_LIBTRANSCRIPT
	bool "libtranscript"
	depends on BR2_TOOLCHAIN_HAS_THREADS
	select BR2_PACKAGE_HOST_CROSS_LIBTOOL
	help
	  Library providing terminal input and output abstractions for
	  console applications, including character set and line discipline
	  handling. It is used by the tilde text editor and by other T3
	  libraries.

	  https://os.ghalkes.nl/t3/libtranscript.html
```

## package/macro11/Config.in
```kconfig
config BR2_PACKAGE_MACRO11
    bool "MACRO-11"
    help
      A MACRO-11 assembler for the PDP-11.
```

## package/open-simh/Config.in
```kconfig
config BR2_PACKAGE_OPEN_SIMH
    bool "Open SIMH PDP-11"
    help
      A Open SIMH simulator for the PDP-11.
```

## package/pdp11monloader/Config.in
```kconfig
config BR2_PACKAGE_PDP11MONLOADER
    bool "pdp11monloader"
    help
      A tool to download code into vintage PDP-11 computers over serial connection using the console monitor.
```

## package/qunibone-boot-roms/Config.in
```kconfig
config BR2_PACKAGE_QUNIBONE_BOOT_ROMS
    bool "PDP-11 boot ROMs"
    help
      Boot ROMs for for various PDP-11 peripheral devices, directly loadable by UniBone/QBone.
```

## package/qunibone-os-images/Config.in
```kconfig
config BR2_PACKAGE_QUNIBONE_OS_IMAGES
    bool "UniBone / QBone OS Images"
    help
      Command scripts and disk images for booting various PDP-11 operating systems.
```

## package/qunibone/Config.in
```kconfig
config BR2_PACKAGE_QUNIBONE
    bool "UniBone / QBone Software"
    help
      Software for the UniBone / QBone Linux-to-PDP-11 bridge.

if BR2_PACKAGE_QUNIBONE

choice
    prompt "QUniBone platform"
    default BR2_PACKAGE_QUNIBONE_PLATFORM_UNIBUS

config BR2_PACKAGE_QUNIBONE_PLATFORM_UNIBUS
    bool "UNIBUS"
    help
      Build for UNIBUS platform.

config BR2_PACKAGE_QUNIBONE_PLATFORM_QBUS
    bool "QBUS"
    help
      Build for QBUS platform.

endchoice

config BR2_PACKAGE_QUNIBONE_DEBUG
    bool "Enable debug build"
    default n
    help
      Build with debug enabled.

endif
```

## package/retro-fuse/Config.in
```kconfig
config BR2_PACKAGE_RETRO_FUSE
    bool "retro-fuse"
    help
      User-space filesystem (FUSE) for accessing ancient Unix filesystems.
```

## package/tilde/Config.in
```kconfig
config BR2_PACKAGE_TILDE
	bool "tilde"
	depends on BR2_TOOLCHAIN_HAS_THREADS
	depends on BR2_INSTALL_LIBSTDCPP
	select BR2_PACKAGE_HOST_CROSS_LIBTOOL
	select BR2_PACKAGE_LIBT3CONFIG
	select BR2_PACKAGE_LIBT3HIGHLIGHT
	select BR2_PACKAGE_LIBT3WIDGET
	select BR2_PACKAGE_LIBTRANSCRIPT
	select BR2_PACKAGE_LIBUNISTRING
	help
	  Tilde is a text editor for the console/terminal which provides an intuitive
	  interface for people accustomed to GUI environments such as Gnome, KDE
	  and Windows.

	  https://os.ghalkes.nl/tilde/index.html
```

## package/xxdpdir/Config.in
```kconfig
config BR2_PACKAGE_XXDPDIR
    bool "XXDPDIR"
    depends on BR2_PACKAGE_PERL
    help
      DEC PDP-11 XXDP (DOS-11) file system manipulation program.
```
